/*
TinyOzSLIM.cpp - 0.96' I2C 128x64 OLED Driver Library
2014 Copyright (c) OscarLiang.net  All right reserved.

Author: Oscar Liang

This library is free software; you can redistribute it and/or
modify it under the terms of the GNU Lesser General Public
License as published by the Free Software Foundation; either
version 2.1 of the License, or (at your option) any later version.

This library is distributed in the hope that it will be useful,
but WITHOUT ANY WARRANTY; without even the implied warranty of
MERCHANTABILITY or FITNESS FOR A PARTICULAR PURPOSE.  See the GNU
Lesser General Public License for more details.

Uses TinyWireM instead of Wire library. For Attiny processors
Change done by Andreas Spiess, sensorsiot@gmail.com

Uses slimmed down OzOled cpp. Using ATtiny85 processor
with 128X64 OLED SSD1306 to display Change done by Jackie Thomas,jackiethomaz@gmail.com

*/


// change init to hard code numbers JT  and send command stream
// delete all functions except basic for diagnotic testing
#include "TinyOzSLIM.h"
#include <TinyWireM.h>
#include <avr/pgmspace.h>
#include "dht.h"
#include "HUMIDITY.h"
#include "BIGTEMP.h"



//8X8 font, Only capital letters

const unsigned char BasicFontAllCaps[][8] PROGMEM = {
	{0x00,0x7F,0x49,0x49,0x49,0x36,0x00,0x00},
	{0x00,0x3E,0x41,0x41,0x41,0x22,0x00,0x00},
	{0x00,0x7F,0x41,0x41,0x22,0x1C,0x00,0x00},
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	{0x00,0x02,0x05,0x05,0x02,0x00,0x00,0x00}
};


// Big numbers font, from 0 to 9 - 96 bytes each.
const byte bigNumber [][96] PROGMEM = {
	{0x00, 0x00, 0x00, 0x00, 0x00, 0x00, 0x00, 0x00, 0x00, 0x00, 0x00, 0x00, 0x00, 0x00, 0x00, 0x00,
		0x00, 0x00, 0x00, 0x00, 0x00, 0x00, 0x00, 0x00, 0x00, 0x00, 0x00, 0x00, 0x00, 0x00, 0x00, 0x00,
		0x00, 0x00, 0x00, 0x00, 0x00, 0x00, 0x00, 0x00, 0x00, 0x00, 0x00, 0x00, 0x00, 0x00, 0x00, 0x00,
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	0x00, 0x00, 0x01, 0x01, 0x01, 0x01, 0x00, 0x00, 0x00, 0x00, 0x00, 0x00, 0x00, 0x00, 0x00, 0x00}
};


// ====================== LOW LEVEL =========================

void OzSLIM::sendCommand(byte command){
	TinyWireM.beginTransmission(OLED_ADDRESS); // begin transmitting
	TinyWireM.send(OzSLIM_COMMAND_MODE);     //command mode  0x80 Single Command Byte
	TinyWireM.send(command);
	TinyWireM.endTransmission();             // stop transmitting
}


void OzSLIM::sendData(byte data){
	
	TinyWireM.beginTransmission(OLED_ADDRESS); // begin transmitting
	TinyWireM.send(OzSLIM_DATA_MODE);          //data mode  0x40 Data Stream
	TinyWireM.send(data);
	TinyWireM.endTransmission();    // stop transmitting

}
void OzSLIM::drawBitmap(const byte *bitmaparray, byte X, byte Y, byte width, byte height){

	// max width = 16
	// max height = 8

	setCursorXY( X, Y );
	
	byte column = 0;
	for(int i=0; i<width*8*height; i++) {  //width 16 *  8  *  8 = 1024 bytes total or 1K

		sendData(pgm_read_byte(&bitmaparray[i]));
		
		if(++column == width*8) {       //first time col = 1 firs time = 16*8 (128)  when reach 128,
			column = 0;                  //set col = 0
			setCursorXY( X, ++Y );       //increment y
		}
	}

}

void OzSLIM::printChar(char C, byte X, byte Y){
	int startFont = 65;  //caps
	//int startFont = 32 for original font
	if ( X < 128 )
	setCursorXY(X, Y);

	//Ignore unused ASCII characters. Modified the range to support multilingual characters.
	// if(C < 32 || C > 127)
	
	if(C < startFont || C > 127)	C='*'; //star - only allow caps

	
	for(byte i=0; i<8; i++) {
		
		//read bytes from code memory
		sendData(pgm_read_byte(&BasicFontAllCaps[C-startFont][i])); //font array starts at 0, ASCII starts at start font. Hence the translation
		
	}
}


void OzSLIM::printString(const char *String, byte X, byte Y, byte numChar){

	if ( X < 128 )
	setCursorXY(X, Y);

	
	byte count=0;
	while(String[count] && count<numChar){
		printChar(String[count++]);
	}

}




void OzSLIM::printBigNumber(const char *number, byte X, byte Y, byte numChar){
	// big number pixels: 24 x 32

	// Y - page
	byte column = 0;
	byte count = 0;

	while(number[count] && count<numChar){
		
		
		setCursorXY(X, Y);
		
		for(byte i=0; i<96; i++) {
			
			// if character is not "0-9" or ':'
			if(number[count] < 46 || number[count] > 58)
			sendData(0);
			else
			sendData(pgm_read_byte(&bigNumber[number[count]-46][i]));
			
			
			if(column >= 23){
				column = 0;
				setCursorXY(X, ++Y);
			}
			else
			column++;

		}
		
		count++;
		
		X = X + 3;
		Y = Y - 4;
		
		
	}

	
	
}





// =================== High Level ===========================

void OzSLIM::init(){
	
	
	
	//JT change 2 hardcode all command numbers


	TinyWireM.begin();
	TinyWireM.beginTransmission(0x3C);   // 3C oled address
	TinyWireM.send(0x00);  // command mode
	TinyWireM.send(0xAE);  // Power off
	TinyWireM.send(0xAF);  //  Power on
	
	TinyWireM.send(0xA6);     //   Normal Display
	TinyWireM.send(0x02);     //Address Mode of page
	
	TinyWireM.send(0x8d); //Charge Pump
	TinyWireM.send(0x14);
	TinyWireM.send(0x81);   //set brightness
	TinyWireM.send(0xFE);   // set highest
	TinyWireM.endTransmission();

}



void OzSLIM::clearDisplay()	{


	for(byte page=0; page<8; page++) {
		
		setCursorXY(0, page);
		for(byte column=0; column<128; column++){  //clear all columns
			sendData(0);
		}

	}
	
	setCursorXY(0,0);
	
}

void OzSLIM::setCursorXY(byte X, byte Y){
	// Y - 1 unit = 1 page (8 pixel rows)
	// X - 1 unit = 8 pixel columns

	sendCommand(0x00 + (8*X & 0x0F)); 		//set column lower address
	sendCommand(0x10 + ((8*X>>4)&0x0F)); 	//set column higher address
	sendCommand(0xB0 + Y); 					//set page address
	
}
void OzSLIM::initForHeartBeat(int pinHB, int delayTime)
{
	pinMode(pinHB, OUTPUT);       //  id the heartbeat LED
	digitalWrite(pinHB, HIGH);    // turn the LED on (HIGH is the voltage level)
	delay(delayTime);            //  wait a bit
	digitalWrite(pinHB, LOW);    // turn the LED off, too bright distracts from LED only on startup
}
void OzSLIM::initOled(int delayTimeOled)
{
	init();  // set normal display, cleardisplay, setcur 0,0
	sendCommand(0xA1);        // set Orientation
	sendCommand(0xC8);
	clearDisplay();   //clear and set cursor 0.0
	printString("INITIALIZE",0,0);  //yes, we are alive!

	delay(delayTimeOled);
	clearDisplay();   //clear and set cursor 0.0
	delay(delayTimeOled);
}

void OzSLIM::initDHT11(int delayTimeDHT11){
	printString("READ DHT11",0,0);   //reading the DHT for the 1st time
	delay(delayTimeDHT11);
	clearDisplay();   //clear and set cursor 0.0
	delay(delayTimeDHT11);
}

void OzSLIM::getTemp (int dht_apin, int dht11DelayTime) {   //pass the pin number for DHT11
	
	
	//  actual read here
	
	int chk = DHT.read11(dht_apin);
	switch (chk)
	{
		case DHTLIB_OK:
		
		OzSlim.drawBitmap(BIGTEMP, 0, 0, 16,4);       //display the word TEMP
		char tmp[10];                                 
		float hold =(DHT.temperature*1.8) +32; //conversion for F
		
		dtostrf(hold, 1, 2, tmp);   //display the temp
		OzSlim.printBigNumber(tmp, 0, 4, 4);//scoot the number down
		delay(dht11DelayTime);
		OzSlim.clearDisplay();
		//  now...for humidity
		
		OzSlim.drawBitmap(BIGHUMIDITY, 0, 0, 16, 4);  //display humidity 2nd
		
		
		dtostrf(DHT.humidity, 1, 2, tmp);
		OzSlim.printBigNumber(tmp, 0, 4, 4);
		delay(dht11DelayTime);
		OzSlim.clearDisplay();
		
		break;
		case DHTLIB_ERROR_CHECKSUM:
		OzSlim.printString("CKSUM");
		delay(dht11DelayTime);
		OzSlim.clearDisplay();
		break;
		case DHTLIB_ERROR_ACK_H:
		OzSlim.printString("ACK H");
        delay(dht11DelayTime);
		OzSlim.clearDisplay();
		break;
		case DHTLIB_ERROR_ACK_L:
		OzSlim.printString("ACK L");
		delay(dht11DelayTime);
		OzSlim.clearDisplay();
		break;
		case DHTLIB_ERROR_TIMEOUT:
		OzSlim.printString("TIMEOUT");
        delay(dht11DelayTime);
		OzSlim.clearDisplay();
		break;
		default:
		OzSlim.printString("UNK ERR");
        delay(dht11DelayTime);
		OzSlim.clearDisplay();
		break;
	}
}


OzSLIM OzSlim;  // Preinstantiate Objects

